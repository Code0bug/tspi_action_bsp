## buildroot/external/Config.in
```kconfig
menu "Tspi Action"
source "$BR2_EXTERNAL_TSPI_ACTION_PATH/package/tspi_action_source/Config.in"
endmenu
```

## buildroot/external/package/tspi_action_source/Config.in
```kconfig
config BR2_PACKAGE_TSPI_ACTION_SOURCE
	bool "tspi_action_source"
	depends on BR2_PACKAGE_QT5
	depends on BR2_PACKAGE_QT5_GL_AVAILABLE
	depends on BR2_TOOLCHAIN_HAS_THREADS
	depends on BR2_USE_MMU
	select BR2_PACKAGE_QT5BASE_GUI
	select BR2_PACKAGE_QT5BASE_WIDGETS
	select BR2_PACKAGE_QT5BASE_OPENGL
	select BR2_PACKAGE_QT5BASE_OPENGL_LIB
	select BR2_PACKAGE_OPENCV4
	select BR2_PACKAGE_FFMPEG
	select BR2_PACKAGE_ROCKCHIP_RGA
	select BR2_PACKAGE_ROCKCHIP_MPP
	select BR2_PACKAGE_LIBDRM
	select BR2_PACKAGE_ALSA_LIB
	select BR2_PACKAGE_DBUS
	help
	  Tspi Action camera application.
	  Installs camera-ui, media-service, libmedia_hal and the qtspi
	  platform plugin.
	  Source: git@gitee.com:lzp1733149755/tspi_action_source.git

comment "tspi_action_source needs Qt5 with OpenGL and a toolchain w/ threads"
	depends on BR2_USE_MMU
	depends on !BR2_PACKAGE_QT5 || !BR2_PACKAGE_QT5_GL_AVAILABLE || \
		!BR2_TOOLCHAIN_HAS_THREADS
```
